## base_external/package/aesdchar/Config.in
```kconfig
config BR2_PACKAGE_AESDCHAR
	bool "AESDCHAR"
	depends on BR2_LINUX_KERNEL
	help
	  Includes the char device LKM
```

## base_external/package/ldd/Config.in
```kconfig
config BR2_PACKAGE_LDD
	bool "LDD"
	depends on BR2_LINUX_KERNEL
	help
	  Includes the LKMs.
```
